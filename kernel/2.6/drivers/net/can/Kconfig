## kernel/2.6/drivers/net/can/Kconfig
```kconfig
menu "CAN Device Drivers"
	depends on CAN

config CAN_VCAN
	tristate "Virtual Local CAN Interface (vcan)"
	depends on CAN
	default N
	---help---
	  Similar to the network loopback devices, vcan offers a
	  virtual local CAN interface.

	  This driver can also be built as a module.  If so, the module
	  will be called vcan.

config CAN_SLCAN
	tristate "Serial / USB serial CAN Adaptors (slcan)"
	depends on CAN
	default N
	---help---
	  CAN driver for several 'low cost' CAN interfaces that are attached
	  via serial lines or via USB-to-serial adapters using the LAWICEL
	  ASCII protocol. The driver implements the tty linediscipline N_SLCAN.

	  As only the sending and receiving of CAN frames is implemented, this
	  driver should work with the (serial/USB) CAN hardware from:
	  www.canusb.com / www.can232.com / www.mictronics.de / www.canhack.de

	  Userspace tools to attach the SLCAN line discipline (slcan_attach,
	  slcand) can be found in the can-utils at the SocketCAN SVN, see
	  http://developer.berlios.de/projects/socketcan for details.

	  The slcan driver supports up to 10 CAN netdevices by default which
	  can be changed by the 'maxdev=xx' module option. This driver can
	  also be built as a module. If so, the module will be called slcan.

config CAN_OLD_DRIVERS
	tristate "Prompt for old CAN drivers (e.g. no sysfs support)"
	depends on CAN
	default N
	---help---
	  The old drivers do not support sysfs nor proper platform device
	  support. Some of the old drivers might only be configured by
	  module commandline options.

if CAN_OLD_DRIVERS
source "drivers/net/can/old/Kconfig"
endif

config CAN_DEV
	tristate "Platform CAN drivers with Netlink support"
	depends on CAN
	default y
	---help---
	  Enables the common framework for platform CAN drivers with Netlink
	  support. This is the standard library for CAN drivers.
	  If unsure, say Y.

config CAN_DEV_SYSFS
	bool "Support for sysfs interface (deprecated)"
	depends on CAN_DEV && SYSFS
	default N
	---help---
	  Adds support for the legacy sysfs interface to configure CAN
	  devices. If possible, please use the new netlink interface
	  instead.
	  If unsure, say N.

config CAN_CALC_BITTIMING
	bool "CAN bit-timing calculation"
	depends on CAN_DEV
	default y
	---help---
	  If enabled, CAN bit-timing parameters will be calculated for the
	  bit-rate specified via Netlink argument "bitrate" when the device
	  get started. This works fine for the most common CAN controllers
	  with standard bit-rates but may fail for exotic bit-rates or CAN
	  source clock frequencies. Disabling saves some space, but then the
	  bit-timing parameters must be specified directly using the Netlink
	  arguments "tq", "prop_seg", "phase_seg1", "phase_seg2" and "sjw".
	  If unsure, say Y.

config CAN_ESD_PCI331
	tristate "ESD CAN 331 Cards"
	depends on PCI && CAN_DEV
	---help---
	  This driver supports the PCI/331, CPCI/331 and PMC/331 CAN cards
	  from the esd system design gmbh (http://www.esd.eu).

config CAN_SOFTING
	tristate "Softing Gmbh CAN generic support"
	depends on CAN_DEV
	---help---
	  generic softing CAN cards
	  Sofing CAN cards come with 1 or 2 physical busses.
	  The API of the card does not allow fine control per bus, but
	  controls the 2 busses on the card together.
	  As such, some actions (start/stop/busoff recovery) on 1 bus
	  must bring down the other bus too temporarily.
	  You have been warned.
	  This driver is written on safe on 64bit, but not on big endian.

config CAN_SOFTING_CS
	tristate "Softing CAN pcmcia cards"
	depends on CAN_SOFTING && PCMCIA
	---help---
	  Support for PCMCIA cards from Softing Gmbh & some cards
	  from Vector Gmbh.
	  You need firmware for these, which you can get at
	  http://developer.berlios.de/projects/socketcan/
	  This version of the driver is written against
	  firmware version 4.6

config CAN_AT91
	tristate "Atmel AT91 onchip CAN controller"
	depends on CAN_DEV && ARCH_AT91SAM9263
	default N
	---help---
	  This is a driver for the SoC CAN controller in Atmel's AT91SAM9263.

config CAN_MCP251X
	tristate "Microchip MCP251x SPI CAN controllers"
	depends on CAN_DEV && SPI
	---help---
	  Driver for the Microchip MCP251x SPI CAN controllers.

source "drivers/net/can/cc770/Kconfig"

source "drivers/net/can/mscan/Kconfig"

source "drivers/net/can/sja1000/Kconfig"

source "drivers/net/can/usb/Kconfig"

config CAN_DEBUG_DEVICES
	bool "CAN devices debugging messages"
	depends on CAN
	default N
	---help---
	  Say Y here if you want the CAN device drivers to produce a bunch of
	  debug messages to the system log.  Select this if you are having
	  a problem with CAN support and want to see more of what is going
	  on.

endmenu
```

## kernel/2.6/drivers/net/can/Kconfig.kernel
```kconfig
menu "CAN Device Drivers"
	depends on CAN

config CAN_VCAN
	tristate "Virtual Local CAN Interface (vcan)"
 	depends on CAN
	default N
 	---help---
	  Similar to the network loopback devices, vcan offers a
	  virtual local CAN interface.

	  This driver can also be built as a module.  If so, the module
	  will be called vcan.

endmenu
```

## kernel/2.6/drivers/net/can/cc770/Kconfig
```kconfig
menuconfig CAN_CC770
	tristate "Bosch CC770 and Intel AN82527 devices"
	depends on CAN_DEV && HAS_IOMEM

if CAN_CC770

config CAN_CC770_ISA
	depends on ISA
	tristate "ISA Bus based legacy CC770 driver"
	---help---
	  This driver adds legacy support for CC770 and AN82527 chips
	  connected to the ISA bus using I/O port, memory mapped or
	  indirect access.

config CAN_CC770_OF_PLATFORM
	depends on PPC_OF
	tristate "Generic OF Platform Bus based CC770 driver"
	---help---
	  This driver adds support for the CC770 and other AN82527
	  compatible chips connected to the OpenFirmware "platform bus"
	  found on embedded systems with OpenFirmware bindings, e.g. if
	  you have a PowerPC based system you may want to enable this
	  option.

endif
```

## kernel/2.6/drivers/net/can/old/Kconfig
```kconfig
config CAN_SJA1000_OLD
	depends on CAN_OLD_DRIVERS
	tristate "Philips SJA1000 (old)"
	---help---
	  The SJA1000 is one of the top CAN controllers out there. As it
	  has a multiplexed interface it fits directly to 8051
	  microcontrollers or into the PC I/O port space. The SJA1000
	  is a full CAN controller, with shadow registers for RX and TX.
	  It can send and receive any kinds of CAN frames (SFF/EFF/RTR)
	  with a single (simple) filter setup.
	  REMARK: This is the 'old' driver originally written by Matthias
	  Brukner and Oliver Hartkopp which uses a non-standard hardware
	  abstaction layer (HAL) inspired by the OCAN driver.

config CAN_I82527_OLD
	depends on CAN_OLD_DRIVERS
	tristate "Intel 82527 (old)"
	---help---
	  The i82527 is a complex CAN controller that can handle RTR
	  frame replies on it's own. This feature (and diffent RX filters)
	  lead to an amount of 15 message objects (for RX & TX). Message
	  object 15 has (as only) a shadow register for a reliable
	  receiption of EFF or(!) SFF frames at high CAN traffic.
	  This driver can send each type of CAN frames (SFF/EFF/RTR).
	  Using 4 message objects it can also receive each type of CAN
	  frames. But due to the onchip filter matching trigger method
	  it is not possible to determine the received RTR CAN-ID.
	  The reliable message object 15 receives SFF frames by default.
	  This message object 15 usage maybe changed with the mo15 param.
	  REMARK: This is the 'old' driver originally written by Oliver
	  Hartkopp which uses a non-standard hardware abstaction layer (HAL)
	  inspired by the OCAN driver. http://ar.linux.it/software/#ocan

config CAN_MSCAN_OLD
	depends on CAN_OLD_DRIVERS && (PPC || M68K || M68KNOMMU)
	tristate "Support for a Freescale MSCAN based chips (old)"
	---help---
	  The Motorola Scalable Controller Area Network (MSCAN) definition
	  is based on the MSCAN12 definition which is the specific
	  implementation of the Motorola Scalable CAN concept targeted for
	  the Motorola MC68HC12 Microcontroller Family.

config CAN_MPC52XX_OLD
	tristate "Freescale MPC5200 onboard CAN controller (old)"
	depends on CAN_MSCAN_OLD && (PPC_MPC52xx || PPC_52xx)
	default LITE5200
	---help---
	  If you say yes here you get support for Freescale MPC5200
	  onboard dualCAN controller.

	  This driver can also be built as a module.  If so, the module
	  will be called mpc52xx_can.

config CAN_CCAN_OLD
	depends on CAN_OLD_DRIVERS
	tristate "Bosch CCAN driver (old)"
	---help---
	  This is a driver for the Bosch CCAN controller found for example
	  on the hynix h7202 chip.

config CAN_H7202_OLD
	tristate "Hynix H7202 onboard CAN controller (old)"
	depends on CAN_CCAN_OLD
	---help---
	  This is a driver for the hynix h7202 can controller.
```

## kernel/2.6/drivers/net/can/sja1000/Kconfig
```kconfig
menuconfig CAN_SJA1000
	tristate "Philips/NXP SJA1000 devices"
	depends on CAN_DEV && HAS_IOMEM

if CAN_SJA1000

config CAN_SJA1000_ISA
	tristate "ISA Bus based legacy SJA1000 driver"
	depends on ISA
	---help---
	  This driver adds legacy support for SJA1000 chips connected to
	  the ISA bus using I/O port, memory mapped or indirect access.

config CAN_SJA1000_PLATFORM
	tristate "Generic Platform Bus based SJA1000 driver"
	---help---
	  This driver adds support for the SJA1000 chips connected to
	  the "platform bus" (Linux abstraction for directly to the
	  processor attached devices).  Which can be found on various
	  boards from Phytec (http://www.phytec.de) like the PCM027,
	  PCM038.

config CAN_SJA1000_OF_PLATFORM
	tristate "Generic OF Platform Bus based SJA1000 driver"
	depends on PPC_OF
	---help---
	  This driver adds support for the SJA1000 chips connected to
	  the OpenFirmware "platform bus" found on embedded systems with
	  OpenFirmware bindings, e.g. if you have a PowerPC based system
	  you may want to enable this option.

config CAN_EMS_PCI
	tristate "EMS CPC-PCI, CPC-PCIe and CPC-104P Card"
	depends on PCI
	---help---
	  This driver is for the one, two or four channel CPC-PCI,
	  CPC-PCIe and CPC-104P cards from EMS Dr. Thomas Wuensche
	  (http://www.ems-wuensche.de).

config CAN_EMS_PCMCIA
	tristate "EMS CPC-CARD Card"
	depends on PCMCIA && CAN_SJA1000
	---help---
	  This driver is for the one or two channel CPC-CARD cards from
	  EMS Dr. Thomas Wuensche (http://www.ems-wuensche.de).

config CAN_EMS_104M
	tristate "EMS CPC-104M Card"
	depends on ISA && CAN_SJA1000
	---help---
	  This driver is for the one, two or four channel CPC-104M cards
	  from EMS Dr. Thomas Wuensche (http://www.ems-wuensche.de).

config CAN_ESD_PCI
	tristate "ESD PCI Cards"
	depends on PCI && CAN_SJA1000
	---help---
	  This driver supports the esd PCI CAN cards CAN-PCI/200,
	  CAN-PCI/266, CAN-PMC/266 (PMC), CAN-CPCI/200 (CompactPCI),
	  CAN-PCIe2000 (PCI Express) and CAN-PCI104/200 (PCI104)
	  from the esd electronic system design gmbh (http://www.esd.eu).

config CAN_IXXAT_PCI
	tristate "IXXAT PCI Card"
	depends on PCI && CAN_SJA1000
	---help---
	  This driver is for the IXXAT PC-I 04/PCI card (1 or 2 channel)
	  from the IXXAT Automation GmbH (http://www.ixxat.de).

config CAN_KVASER_PCI
	tristate "Kvaser PCIcanx and Kvaser PCIcan PCI Cards"
	depends on PCI
	---help---
	  This driver is for the the PCIcanx and PCIcan cards (1, 2 or
	  4 channel) from Kvaser (http://www.kvaser.com).

config CAN_PEAK_PCI
	tristate "PEAK PCAN PCI Card"
	depends on PCI && CAN_SJA1000
	---help---
	  This driver is for the PCAN PCI, the PC-PCI CAN plug-in card (1 or
	  2 channel) from PEAK Systems (http://www.peak-system.com).

config CAN_PLX_PCI
	tristate "PLX90xx PCI-bridge based Cards"
	depends on PCI
	---help---
	  This driver is for CAN interface cards based on
	  the PLX90xx PCI bridge.
	  Driver supports now:
	   - Adlink PCI-7841/cPCI-7841 card (http://www.adlinktech.com/)
	   - Adlink PCI-7841/cPCI-7841 SE card
	   - Marathon CAN-bus-PCI card (http://www.marathon.ru/)
	   - TEWS TECHNOLOGIES TPMC810 card (http://www.tews.com/)

config CAN_PIPCAN
	depends on CAN_SJA1000
	tristate "MPL PIPCAN CAN module driver (SJA1000)"
	---help---
	  This driver adds support for the PIPCAN module used on some SBC
	  boards from MPL AG (http://www.mpl.ch).

endif
```

## kernel/2.6/net/can/Kconfig
```kconfig
#
# Controller Area Network (CAN) network layer core configuration
#

menuconfig CAN
	depends on NET
	tristate "CAN bus subsystem support"
	---help---
	  Controller Area Network (CAN) is a slow (up to 1Mbit/s) serial
	  communications protocol, which was developed by Bosch at
	  1991 mainly for automotive, but now widely used in marine
	  (NMEA2000), industrial and medical applications.
	  More information on the CAN network protocol family PF_CAN
	  is contained in <Documentation/networking/can.txt>.

	  If you want CAN support, you should say Y here and also to the
	  specific driver for your controller(s) below.

config CAN_RAW
	tristate "Raw CAN Protocol (raw access with CAN-ID filtering)"
	depends on CAN
	default N
	---help---
	  The Raw CAN protocol option offers access to the CAN bus via
	  the BSD socket API. You probably want to use the raw socket in
	  most cases where no higher level protocol is being used. The raw 
	  socket has several filter options e.g. ID-Masking / Errorframes.
	  To receive/send raw CAN messages, use AF_CAN with protocol CAN_RAW.

config CAN_RAW_USER
	bool "Allow non-root users to access Raw CAN Protocol sockets"
	depends on CAN_RAW
	default N
	---help---
	  The Controller Area Network is a local field bus transmitting only
	  broadcast messages without any routing and security concepts.
	  In the majority of cases the user application has to deal with
	  raw CAN frames. Therefore it might be reasonable NOT to restrict
	  the CAN access only to the user root, as known from other networks.
	  Say Y here if you want non-root users to be able to access CAN_RAW-
	  sockets.

config CAN_BCM
	tristate "Broadcast Manager CAN Protocol (with content filtering)"
	depends on CAN
	default N
	---help---
	  The Broadcast Manager offers content filtering, timeout monitoring,
	  sending of RTR-frames and cyclic CAN messages without permanent user
	  interaction. The BCM can be 'programmed' via the BSD socket API and
	  informs you on demand e.g. only on content updates / timeouts.
	  You probably want to use the bcm socket in most cases where cyclic
	  CAN messages are used on the bus (e.g. in automotive environments).
	  To use the Broadcast Manager, use AF_CAN with protocol CAN_BCM.

config CAN_BCM_USER
	bool "Allow non-root users to access CAN broadcast manager sockets"
	depends on CAN_BCM
	default N
	---help---
	  The Controller Area Network is a local field bus transmitting only
	  broadcast messages without any routing and security concepts.
	  In the majority of cases the user application has to deal with
	  raw CAN frames. Therefore it might be reasonable NOT to restrict
	  the CAN access only to the user root, as known from other networks.
	  Say Y here if you want non-root users to be able to access CAN_BCM-
	  sockets.

config CAN_DEBUG_CORE
	bool "CAN Core debugging messages"
	depends on CAN
	---help---
	  Say Y here if you want the CAN core to produce a bunch of debug
	  messages to the system log.  Select this if you are having a
	  problem with CAN support and want to see more of what is going on.


source "drivers/net/can/Kconfig"
```
